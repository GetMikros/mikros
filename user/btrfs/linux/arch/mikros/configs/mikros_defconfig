## user/btrfs/linux/arch/mikros/configs/mikros_defconfig
```kconfig
# The options the btrfs shim builds with, from allnoconfig.
CONFIG_EXPERT=y
CONFIG_BLOCK=y
CONFIG_BTRFS_FS=y
CONFIG_PRINTK=y
CONFIG_BUG=y
CONFIG_MULTIUSER=y
CONFIG_FILE_LOCKING=y
# Off, with EXPERT: what nothing in the shim uses.
CONFIG_KALLSYMS=n
CONFIG_FUTEX=n
CONFIG_EPOLL=n
CONFIG_SIGNALFD=n
CONFIG_TIMERFD=n
CONFIG_EVENTFD=n
CONFIG_AIO=n
CONFIG_IO_URING=n
CONFIG_ADVISE_SYSCALLS=n
CONFIG_MEMBARRIER=n
CONFIG_POSIX_TIMERS=n
CONFIG_CACHESTAT_SYSCALL=n
CONFIG_FHANDLE=n
CONFIG_SYSCTL=n
CONFIG_ELF_CORE=n
CONFIG_COREDUMP=n
CONFIG_PROC_FS=n
CONFIG_SYSFS=n
CONFIG_INPUT=n
CONFIG_TTY=n
CONFIG_VT=n
CONFIG_FW_LOADER=n
CONFIG_SLUB_DEBUG=n
CONFIG_DEBUG_MEMORY_INIT=n
CONFIG_MSDOS_PARTITION=n
CONFIG_EFI_PARTITION=n
CONFIG_PARTITION_ADVANCED=y
CONFIG_NAMESPACES=n
CONFIG_VM_EVENT_COUNTERS=n
CONFIG_CRC_OPTIMIZATIONS=n
CONFIG_CPU_MITIGATIONS=n
```
